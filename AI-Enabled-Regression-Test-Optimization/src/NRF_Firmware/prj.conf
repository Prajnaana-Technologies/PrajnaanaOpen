## CMakeLists.txt
```
# Copyright (c) 2026 Prajnaana Technologies Pvt. Ltd.
# SPDX-License-Identifier: MIT
#
# Licensed under the MIT License. See LICENSE in the project root.

cmake_minimum_required(VERSION 3.20.0)

# Devicetree additions, named explicitly rather than left to the
# boards/<board>.overlay convention.
#
# The convention finds this file on its own: for the hardware-model-v2 board
# target "nrf52840dk/nrf52840" Zephyr looks for
# boards/nrf52840dk_nrf52840.overlay, which is exactly this file
# (zephyr_build_string and zephyr_file(CONF_FILES ...) in NCS v3.4.0's
# cmake/modules; the same holds upstream).
#
# Naming it here is explicit and costs nothing: the same overlay is applied
# either way.
#
# Must be set before find_package(Zephyr).
set(EXTRA_DTC_OVERLAY_FILE
    "${CMAKE_CURRENT_SOURCE_DIR}/boards/nrf52840dk_nrf52840.overlay")

find_package(Zephyr REQUIRED HINTS $ENV{ZEPHYR_BASE})
project(AI_TEST_EARBUDS)

# ---------------------------------------------------------------------------
# Build options
#
# Bench builds accept unauthenticated audio writes, so an unattended run needs
# no pairing step; a product build must not. SECURITY.md documents
#
#     west build -b nrf52840dk/nrf52840 -- -DHA_OPEN_WRITE=0
#
# and everything after "--" is a CMake variable, so it has to be forwarded to
# the compiler here. Without that, main.c's "#ifndef HA_OPEN_WRITE" defaults
# it back to 1, the write characteristic keeps BT_GATT_PERM_WRITE, and the
# "secure" image is byte-identical to the bench one.
# ---------------------------------------------------------------------------
set(HA_OPEN_WRITE "1" CACHE STRING
    "1: audio writes need no encryption (bench). 0: require an encrypted link.")

if(NOT HA_OPEN_WRITE MATCHES "^[01]$")
    message(FATAL_ERROR
        "HA_OPEN_WRITE must be 0 or 1, not '${HA_OPEN_WRITE}'")
endif()

if(HA_OPEN_WRITE STREQUAL "0")
    message(STATUS "Audio write requires an encrypted link (HA_OPEN_WRITE=0)")
else()
    message(WARNING
        "Audio write is unauthenticated (HA_OPEN_WRITE=1). Bench only; "
        "build with -DHA_OPEN_WRITE=0 for anything that leaves the lab.")
endif()

# ---------------------------------------------------------------------------
# Build identity
#
# The board reports what it is running, so nobody has to remember or type it.
# The id is "<git describe>+<source hash>". Only the "+hash" half is a
# property of the source: it is the same for identical sources at any commit.
# The describe half moves with every commit, and firmware_diff.py compares
# whole ids, so identical sources rebuilt at a new commit read as an unknown
# change rather than as no change.
#
# describe is asked without --dirty. The "+hash" half already separates two
# images built from different sources, and it is computed from the files
# that go into the image and nothing else, so a "-dirty" marker says nothing
# about the image while firing on any edit anywhere in the tree: a README
# change would label the firmware modified. The determinism KPI compares
# runs sharing an id, and the hash is what makes that comparison sound.
# ---------------------------------------------------------------------------
find_package(Git QUIET)

if(GIT_FOUND)
    execute_process(
        COMMAND ${GIT_EXECUTABLE} describe --always --abbrev=8
        WORKING_DIRECTORY ${CMAKE_CURRENT_SOURCE_DIR}
        OUTPUT_VARIABLE HA_FW_REVISION
        OUTPUT_STRIP_TRAILING_WHITESPACE
        ERROR_QUIET
    )
endif()

if(NOT HA_FW_REVISION)
    set(HA_FW_REVISION "unversioned")
endif()

# A content hash of everything that goes into the image.
#
# git describe alone is not enough to tell two builds apart: it returns the
# same "<commit>-dirty" for every uncommitted state, so a build before an edit
# and a build after it carry identical ids. The host keys its firmware
# fingerprints on this id, so identical ids mean no comparison is possible --
# which is exactly what happened on the bench.
#
# Hashing the sources fixes that. Same sources always hash the same, any edit
# changes it, and no commit is required.
file(GLOB HA_HASHED_SOURCES
    ${CMAKE_CURRENT_SOURCE_DIR}/src/*.c
    ${CMAKE_CURRENT_SOURCE_DIR}/src/*.h
    ${CMAKE_CURRENT_SOURCE_DIR}/boards/*.overlay
)

list(APPEND HA_HASHED_SOURCES
    ${CMAKE_CURRENT_SOURCE_DIR}/prj.conf
)

list(SORT HA_HASHED_SOURCES)

set(HA_CONTENT "")

# Hashed as text with CRLF normalised to LF, so the id is a property of the
# source and not of the checkout. file(SHA256) hashes raw bytes, which gives
# one id for a Windows checkout and another for the same commit on Linux or
# in CI: nobody rebuilding can reproduce the id a RELEASE_NOTES heading
# names, and section_for falls back to the whole note.
foreach(HA_FILE ${HA_HASHED_SOURCES})
    if(EXISTS ${HA_FILE})
        file(READ ${HA_FILE} HA_FILE_TEXT)
        string(REPLACE "\r\n" "\n" HA_FILE_TEXT "${HA_FILE_TEXT}")
        string(SHA256 HA_FILE_HASH "${HA_FILE_TEXT}")
        string(APPEND HA_CONTENT "${HA_FILE_HASH}")
    endif()
endforeach()

# Build options shape the image as much as the sources do: an open-write
# build and an encrypted-write build have identical sources, so without
# this they would share a build id -- and the host keys its fingerprints
# on that.
#
# Only the non-default value is folded in. Appending unconditionally moves
# the default build's id as well, so the delivered firmware.hex, the release
# note, the README and a test all name a build the source does not produce.
# The distinction the hash exists to make is between the two options, and a
# marker on one of them makes it just as well as a marker on both.
if(NOT HA_OPEN_WRITE STREQUAL "1")
    string(APPEND HA_CONTENT "HA_OPEN_WRITE=${HA_OPEN_WRITE}")
endif()

string(SHA256 HA_SOURCE_HASH "${HA_CONTENT}")
string(SUBSTRING ${HA_SOURCE_HASH} 0 8 HA_SOURCE_HASH)

# The hash above is computed when CMake CONFIGURES, not when it builds. An
# incremental build after an edit would otherwise recompile the new code and
# bake the stale id into it: different firmware, identical build id -- the
# same collision the content hash exists to prevent, one level further down.
#
# It matters because the host keys on this id. Two different images sharing
# one id means the determinism KPI compares builds that are not the same
# build, and firmware_diff overwrites the stored fingerprint of one with the
# other.
#
# Listing the hashed files as configure dependencies makes any edit to them
# re-run configure, so the id is recomputed before it is compiled in.
set_property(DIRECTORY APPEND PROPERTY
    CMAKE_CONFIGURE_DEPENDS ${HA_HASHED_SOURCES})

set(HA_FW_REVISION "${HA_FW_REVISION}+${HA_SOURCE_HASH}")

message(STATUS "Firmware build id: ${HA_FW_REVISION}")

# ble_telemetry_service.c publishes the metrics the host risk engine scores.
# Without it the device exposes no telemetry characteristic, the host reports
# power/memory/sync/retry as unmeasured, and test selection has nothing to
# select on.
target_sources(app PRIVATE
    src/main.c
    src/dsp_wdrc.c
    src/ble_telemetry_service.c
)

target_compile_definitions(app PRIVATE
    HA_FW_REVISION="${HA_FW_REVISION}"
    HA_OPEN_WRITE=${HA_OPEN_WRITE}
)
```

## prj.conf
```kconfig
# Copyright (c) 2026 Prajnaana Technologies Pvt. Ltd.
# SPDX-License-Identifier: MIT
#
# Licensed under the MIT License. See LICENSE in the project root.

CONFIG_BT=y
CONFIG_BT_PERIPHERAL=y

# The host scans for a name containing "Zephyr" (regression/ble/ble_audio.py,
# DEVICE_NAME_MATCH). The board currently advertises Zephyr_Earbuds; keep it
# so discovery keeps working. Change both sides together if you rename it.
CONFIG_BT_DEVICE_NAME="Zephyr_Earbuds"

CONFIG_BT_MAX_CONN=1
CONFIG_MAIN_STACK_SIZE=4096

CONFIG_BT_CTLR_TX_PWR_DYNAMIC_CONTROL=y

# ---------------------------------------------------------------------------
# Audio DSP loopback
# ---------------------------------------------------------------------------

# The compressor is float; the nRF52840 is Cortex-M4F.
CONFIG_FPU=y

# Notifications are sent from the system work queue, and float maths plus the
# BLE stack need more room than the 1024-byte default.
CONFIG_SYSTEM_WORKQUEUE_STACK_SIZE=4096

# Throughput: the host streams 4000 bytes as about 32 writes of up to 128
# bytes, 5 ms apart, and expects the same volume notified back. The default
# buffer counts stall under that and the work handler spends its time
# retrying on -ENOMEM.
CONFIG_BT_BUF_ACL_TX_COUNT=10
# Zephyr asserts BT_BUF_EVT_RX_COUNT > BT_BUF_ACL_TX_COUNT. The default RX
# count is 10, so raising TX to 10 without this fails the build.
CONFIG_BT_BUF_EVT_RX_COUNT=12
CONFIG_BT_L2CAP_TX_BUF_COUNT=10
CONFIG_BT_CONN_TX_MAX=10

# Let the MTU negotiate above the 23-byte default. The firmware sizes its
# notifications from the negotiated MTU (notify_chunk_size() in main.c) and
# the host sizes its writes from it independently (MAX_CHUNK in ble_audio.py),
# so a larger one means fewer packets in both directions -- up to MTU 131.
# Above that neither side grows: the host caps a write at 128 bytes and the
# firmware never notifies more than one 128-byte block.
CONFIG_BT_L2CAP_TX_MTU=247
CONFIG_BT_BUF_ACL_TX_SIZE=251
CONFIG_BT_BUF_ACL_RX_SIZE=251
CONFIG_BT_CTLR_DATA_LENGTH_MAX=251

# ---------------------------------------------------------------------------
# The telemetry service (src/ble_telemetry_service.c) is compiled into this
# application and publishes the metrics the risk engine scores.
#
# The service also logs through LOG_INF. This application has CONFIG_LOG off,
# so that output is compiled out; main.c reports an init failure over printk
# instead. Enable CONFIG_LOG=y only if you need the per-sample log, and re-run
# the audio loopback tests afterwards -- it costs RAM the BLE buffers use.
# ---------------------------------------------------------------------------

# Only arms the heap fallback in sample_memory(). That branch is compiled out
# on this build, because CONFIG_HEAP_MEM_POOL_SIZE is 0 and nothing here calls
# k_malloc; it is kept so the fallback works if a heap is ever configured.
CONFIG_SYS_HEAP_RUNTIME_STATS=y

# Stack high-water measurement, which is where mem_used and mem_free actually
# come from. INIT_STACKS fills stacks with 0xAA so unused space can be
# counted; THREAD_STACK_INFO stores the bounds the count needs. Without both,
# the memory fields report 0, the host treats the memory metric as unmeasured,
# and the risk engine scores it as risk rather than as health.
CONFIG_INIT_STACKS=y
CONFIG_THREAD_STACK_INFO=y

# ---------------------------------------------------------------------------
# Pairing and bonding
#
# Without SMP the device cannot pair at all, so a pairing test has nothing to
# exercise. With it, the telemetry service exposes an encryption-required
# characteristic (dee2) that an unpaired central cannot read -- which is what
# makes a pairing test prove an effect rather than a return code.
#
# BT_SETTINGS plus a settings backend is what makes a bond survive a reboot.
# Without persistence the pairing test would pass and the bonding test could
# not exist.
#
# Reflashing erases the NVS partition and with it every stored bond, while
# Windows keeps its side. Remove the device from Windows Bluetooth settings
# after a flash, or the next connection fails on a key mismatch.
# ---------------------------------------------------------------------------
CONFIG_BT_SMP=y
CONFIG_BT_MAX_PAIRED=2

# Let a peer pair again when it already has a bond here.
#
# Without it the board refuses: it still holds a bond from an earlier run
# while the host has forgotten its half, and Zephyr rejects the attempt as a
# re-pair. That is correct for a product and wrong for a bench, where the
# host's bond store is cleared between tests and the device's is not --
# test_pairing_grants_access failed on exactly this.
#
# It is a real weakening: a peer that copies the device address can overwrite
# an unauthenticated bond. Acceptable here because pairing is Just Works
# anyway, which provides no protection against that attacker in the first
# place. A product using authenticated pairing must leave this off.
CONFIG_BT_SMP_ALLOW_UNAUTH_OVERWRITE=y

# When a new bond completes, drop any older bond for the same peer, so the
# bond table cannot fill with stale entries for one host across many runs.
CONFIG_BT_ID_UNPAIR_MATCHING_BONDS=y

CONFIG_BT_SETTINGS=y
CONFIG_SETTINGS=y
CONFIG_SETTINGS_NVS=y
CONFIG_NVS=y
CONFIG_FLASH=y
CONFIG_FLASH_MAP=y
CONFIG_FLASH_PAGE_LAYOUT=y

# --- Battery level -------------------------------------------------------
# The standard Battery Service (0x180F / 0x2A19). read_battery() in
# regression/ble/ble_audio.py reads 0x2A19 directly, and this option is what
# publishes it: without CONFIG_BT_BAS the read fails and battery stays
# unmeasured.
CONFIG_BT_BAS=y

# SAADC, so the level reported is the measured supply rail rather than a
# constant. See boards/nrf52840dk_nrf52840.overlay.
CONFIG_ADC=y
CONFIG_ADC_NRFX_SAADC=y
```

## boards/nrf52840dk_nrf52840.overlay
```dts
/*
 * Copyright (c) 2026 Prajnaana Technologies Pvt. Ltd.
 * SPDX-License-Identifier: MIT
 *
 * Supply voltage on the SAADC, so battery level is measured rather than
 * declared.
 *
 * The DK has no battery and no fuel gauge. What it does have is a supply
 * rail the SoC can measure through the SAADC's internal VDD input, needing
 * no external part and no pin. That is a real quantity that moves when the
 * supply moves, which is enough for the read path, the Battery Service and
 * the tests around them to be exercised honestly.
 *
 * It is not a state of charge. A product would read a fuel gauge and get
 * one; this reports where the rail sits between a brown-out floor and a
 * charged-cell ceiling -- HA_RAIL_EMPTY_MV and HA_RAIL_FULL_MV in
 * src/ble_telemetry_service.c -- and the firmware says so where it converts.
 */

#include <zephyr/dt-bindings/adc/adc.h>
#include <zephyr/dt-bindings/adc/nrf-adc.h>

/ {
	zephyr,user {
		io-channels = <&adc 0>;
	};
};

&adc {
	status = "okay";
	#address-cells = <1>;
	#size-cells = <0>;

	channel@0 {
		reg = <0>;

		/*
		 * Gain 1/6 against the 0.6 V internal reference gives a 3.6 V
		 * full scale, which covers the whole range a supply rail can
		 * sit in without clipping the top of it.
		 */
		zephyr,gain = "ADC_GAIN_1_6";
		zephyr,reference = "ADC_REF_INTERNAL";
		zephyr,acquisition-time = <ADC_ACQ_TIME(ADC_ACQ_TIME_MICROSECONDS, 10)>;
		zephyr,input-positive = <NRF_SAADC_VDD>;
		zephyr,resolution = <12>;
	};
};
```

## src/main.c
```c
/*
 * Copyright (c) 2026 Prajnaana Technologies Pvt. Ltd.
 * SPDX-License-Identifier: MIT
 *
 * Licensed under the MIT License. See LICENSE in the project root.
 */

/*
 * SmartEarbuds / Zephyr_Earbuds -- BLE audio service with DSP loopback.
 *
 * Host streams raw PCM16 to the write characteristic; this firmware runs wide
 * dynamic range compression over it and notifies the processed audio back.
 * That loopback is what makes the host's test_audio_dsp meaningful: without
 * it the test can only ever skip.
 *
 * Service   12345678-1234-5678-1234-56789abcdef0
 *   def1    write, write-without-response   host -> device, raw PCM16
 *   def2    notify                          device -> host, processed PCM16
 *
 * Notifying happens on the system work queue, never inside the ATT write
 * callback -- notifying from there can block the BLE stack and drop audio.
 */

#include <zephyr/bluetooth/bluetooth.h>
#include <zephyr/bluetooth/conn.h>
#include <zephyr/bluetooth/gatt.h>
#include <zephyr/bluetooth/uuid.h>
#include <zephyr/kernel.h>
#include <zephyr/sys/printk.h>
#include <zephyr/sys/ring_buffer.h>

#include <zephyr/settings/settings.h>

#include "ble_telemetry_service.h"
#include "dsp_wdrc.h"

/* BT_LE_ADV_CONN_NAME was removed in Zephyr 4.x. The name now has to go
 * into the advertising payload explicitly, and the host scans for it
 * (DEVICE_NAME_MATCH in regression/ble/ble_audio.py). */
#define DEVICE_NAME     CONFIG_BT_DEVICE_NAME
#define DEVICE_NAME_LEN (sizeof(DEVICE_NAME) - 1)

static const struct bt_data ad[] = {
    BT_DATA_BYTES(BT_DATA_FLAGS, (BT_LE_AD_GENERAL | BT_LE_AD_NO_BREDR)),
    BT_DATA(BT_DATA_NAME_COMPLETE, DEVICE_NAME, DEVICE_NAME_LEN),
};

/*
 * The original firmware dropped TX power and force-disconnected 10 seconds
 * after every connection, to exercise reconnect handling.
 *
 * That must not be on by default. One audio stream is 4000 bytes sent as
 * about 32 writes of up to 128 bytes, 5 ms apart -- roughly 0.2 s, plus a
 * 0.25 s quiet period before the host stops listening. A single stream now
 * finishes well inside 10 s, but the host holds one connection for the whole
 * test session, so a drop at 10 s lands in the middle of some later test.
 *
 * Set to 1 only when you specifically want to test disconnect handling.
 */
#define HA_DISCONNECT_TEST 0
#define HA_DISCONNECT_TEST_SECONDS 10

/*
 * Windows caches a BLE device's GATT database by address and does not
 * reliably notice when the layout changes. After adding the notify
 * characteristic, Windows kept serving handles from the previous build --
 * subscribe failed with "Invalid Handle", and forcing an uncached read
 * failed with "Catastrophic failure". Clearing it needs an elevated
 * pnputil call on the host.
 *
 * Advertising under a fresh address sidesteps that entirely: Windows sees
 * a device it has never met and discovers the database properly. The host
 * scans by name (DEVICE_NAME_MATCH), not by address, so nothing on that
 * side changes.
 *
 * Must be a static random address: the two most significant bits of the
 * first octet have to be 1, so the first octet must be >= 0xC0.
 * Bump this whenever you change the GATT layout.
 */
#define HA_SET_STATIC_ADDR 1
/* Bump whenever the GATT attribute table changes, so a host holding a
 * cached database against the previous address rediscovers the new layout.
 * RELEASE_NOTES.md records which build each bump belongs to. */
#define HA_STATIC_ADDR     "C1:F5:B1:81:20:F2"

/* ================= UUIDs ================= */

/* BT_UUID_INIT_128 takes bytes little-endian: this reads as
 * 12345678-1234-5678-1234-56789abcdef0 and matches the host constants in
 * regression/ble/ble_audio.py. */
static struct bt_uuid_128 service_uuid = BT_UUID_INIT_128(
    0xf0, 0xde, 0xbc, 0x9a,
    0x78, 0x56,
    0x34, 0x12,
    0x78, 0x56,
    0x34, 0x12, 0x78, 0x56, 0x34, 0x12);

static struct bt_uuid_128 write_uuid = BT_UUID_INIT_128(
    0xf1, 0xde, 0xbc, 0x9a,
    0x78, 0x56,
    0x34, 0x12,
    0x78, 0x56,
    0x34, 0x12, 0x78, 0x56, 0x34, 0x12);

/* ...def2 -- the notify characteristic the previous build was missing. */
static struct bt_uuid_128 notify_uuid = BT_UUID_INIT_128(
    0xf2, 0xde, 0xbc, 0x9a,
    0x78, 0x56,
    0x34, 0x12,
    0x78, 0x56,
    0x34, 0x12, 0x78, 0x56, 0x34, 0x12);

/* ================= STATE ================= */

/* Host bursts writes of up to 128 bytes; buffer generously so nothing is
 * dropped while the work queue catches up. */
#define AUDIO_RING_BYTES    4096
#define AUDIO_BLOCK_SAMPLES 64

RING_BUF_DECLARE(audio_ring, AUDIO_RING_BYTES);

/*
 * An odd trailing byte is half a PCM16 sample and has to wait for the next
 * write. It is held here rather than written back into the ring: the ring has
 * a single producer (audio_write), and a put from the work handler would
 * append the byte AFTER data that arrived later, reordering the stream.
 * Today's writes are all even-sized, so this is a guard rather than a path
 * that runs.
 *
 * It lives beside the ring because it has to be discarded with it. As a
 * static inside the work handler it survived a reset, so a leftover byte from
 * one connection was put in front of the next stream and shifted every sample
 * by one byte.
 */
static uint8_t audio_carry;
static bool audio_have_carry;

static void audio_stream_reset(void)
{
    ring_buf_reset(&audio_ring);

    audio_carry = 0;
    audio_have_carry = false;
}

static struct bt_conn *current_conn;
static bool notify_enabled;

static uint32_t total_in;
static uint32_t total_out;
static uint32_t dropped;
static uint32_t seconds_counter;

/* ================= GATT ================= */

static void audio_ccc_changed(const struct bt_gatt_attr *attr, uint16_t value)
{
    ARG_UNUSED(attr);

    notify_enabled = (value == BT_GATT_CCC_NOTIFY);

    printk("Notifications %s\n", notify_enabled ? "enabled" : "disabled");

    if (notify_enabled) {
        /* Fresh subscriber: start the compressor from a known state so the
         * first samples are not shaped by the previous stream. */
        wdrc_reset();
        audio_stream_reset();
    }
}

static void audio_work_handler(struct k_work *work);
static K_WORK_DEFINE(audio_work, audio_work_handler);

static ssize_t audio_write(struct bt_conn *conn,
                           const struct bt_gatt_attr *attr,
                           const void *buf, uint16_t len,
                           uint16_t offset, uint8_t flags)
{
    ARG_UNUSED(attr);
    ARG_UNUSED(offset);
    ARG_UNUSED(flags);

    current_conn = conn;
    total_in += len;

    uint32_t written = ring_buf_put(&audio_ring, buf, len);

    if (written < len) {
        /* Host is streaming faster than the DSP drains it. Count it rather
         * than truncating silently -- a full ring is a real finding. */
        dropped += (len - written);
        ha_telemetry_note_stream_error();
        printk("Ring full, dropped %u bytes (total %u)\n",
               (unsigned)(len - written), (unsigned)dropped);
    }

    k_work_submit(&audio_work);

    return len;
}

/*
 * Write permission on the audio characteristic.
 *
 * HA_OPEN_WRITE=1 (the default) accepts audio from anything in radio range.
 * That is what lets an unattended bench run work with no pairing step, and it
 * is not acceptable in a shipped product: any nearby radio can push samples
 * into the DSP.
 *
 * Build with -DHA_OPEN_WRITE=0 to require an encrypted link instead. The host
 * must then bond before streaming, so expect the first connection after a
 * flash to fail until it does.
 */
#ifndef HA_OPEN_WRITE
#define HA_OPEN_WRITE 1
#endif

#if HA_OPEN_WRITE
#define HA_AUDIO_WRITE_PERM BT_GATT_PERM_WRITE
#else
#define HA_AUDIO_WRITE_PERM BT_GATT_PERM_WRITE_ENCRYPT
#endif

BT_GATT_SERVICE_DEFINE(audio_svc,
    BT_GATT_PRIMARY_SERVICE(&service_uuid),

    BT_GATT_CHARACTERISTIC(&write_uuid.uuid,
                           BT_GATT_CHRC_WRITE | BT_GATT_CHRC_WRITE_WITHOUT_RESP,
                           HA_AUDIO_WRITE_PERM,
                           NULL, audio_write, NULL),

    BT_GATT_CHARACTERISTIC(&notify_uuid.uuid,
                           BT_GATT_CHRC_NOTIFY,
                           BT_GATT_PERM_NONE,
                           NULL, NULL, NULL),

    BT_GATT_CCC(audio_ccc_changed,
                BT_GATT_PERM_READ | BT_GATT_PERM_WRITE),
);

/* attrs: 0 service, 1/2 write chrc+value, 3/4 notify chrc+value, 5 CCC */
#define AUDIO_NOTIFY_ATTR (&audio_svc.attrs[4])

/* ================= PROCESSING ================= */

static uint16_t notify_chunk_size(void)
{
    /* 3 bytes of ATT header. Default MTU 23 leaves 20; this device negotiates
     * 247, which leaves 244 -- but nothing ever sends that much: the work
     * handler holds one 128-byte block, so notifications are at most one
     * 128-byte block. The host sizes its writes separately -- see MAX_CHUNK
     * in ble_audio.py. */
    uint16_t mtu = current_conn ? bt_gatt_get_mtu(current_conn) : 23;
    uint16_t payload = (mtu > 3) ? (mtu - 3) : 20;

    /* Keep it even so a PCM16 sample is never split across notifications. */
    return payload & ~(uint16_t)1;
}

static void audio_work_handler(struct k_work *work)
{
    ARG_UNUSED(work);

    int16_t block[AUDIO_BLOCK_SAMPLES];
    uint8_t *bytes = (uint8_t *)block;

    /* audio_carry holds the odd trailing byte left by the previous pass; it
     * sits beside the ring so a reset discards both. */

    while (!ring_buf_is_empty(&audio_ring)) {

        uint32_t offset = 0;

        if (audio_have_carry) {
            bytes[0] = audio_carry;
            audio_have_carry = false;
            offset = 1;
        }

        uint32_t got = offset + ring_buf_get(&audio_ring, bytes + offset,
                                             sizeof(block) - offset);

        if (got < sizeof(int16_t)) {
            if (got == 1u) {
                audio_carry = bytes[0];
                audio_have_carry = true;
            }

            break;
        }

        if (got & 1u) {
            audio_carry = bytes[got - 1];
            audio_have_carry = true;
            got -= 1;
        }

        wdrc_process(block, got / sizeof(int16_t));

        if (!notify_enabled || !current_conn) {
            continue;   /* nobody subscribed; discard the processed audio */
        }

        uint16_t chunk = notify_chunk_size();
        uint8_t *out = (uint8_t *)block;

        for (uint32_t sent = 0; sent < got; sent += chunk) {

            uint16_t n = (got - sent < chunk) ? (uint16_t)(got - sent) : chunk;

            int err = bt_gatt_notify(current_conn, AUDIO_NOTIFY_ATTR,
                                     out + sent, n);

            if (err == -ENOMEM || err == -EAGAIN) {
                /* Stack buffers are full. Yield and retry this chunk rather
                 * than spinning or dropping it. */
                k_sleep(K_MSEC(2));
                sent -= chunk;
                continue;
            }

            if (err) {
                printk("Notify failed (%d)\n", err);
                break;
            }

            total_out += n;
        }
    }
}

/* ================= ADVERTISING ================= */

static void adv_work_handler(struct k_work *work);

/* Declared before the handler body so the retry path can reschedule it. */
static K_WORK_DELAYABLE_DEFINE(adv_work, adv_work_handler);

static void adv_work_handler(struct k_work *work)
{
    ARG_UNUSED(work);

    int err = bt_le_adv_start(BT_LE_ADV_CONN_FAST_1, ad, ARRAY_SIZE(ad),
                              NULL, 0);

    if (err == -EALREADY) {
        return;                 /* already advertising, nothing to do */
    }

    if (err) {
        printk("Advertising restart failed (%d), retrying\n", err);
        k_work_schedule(&adv_work, K_SECONDS(1));
        return;
    }

    printk("Advertising restarted\n");
}

/* ================= CONNECTION ================= */

static void connected(struct bt_conn *conn, uint8_t err)
{
    if (err) {
        printk("Connection failed (%u)\n", err);
        return;
    }

    current_conn = bt_conn_ref(conn);

    seconds_counter = 0;
    total_in = 0;
    total_out = 0;
    dropped = 0;

    wdrc_reset();
    audio_stream_reset();

    printk("Connected\n");
}

static void security_changed(struct bt_conn *conn, bt_security_t level,
                             enum bt_security_err err)
{
    ARG_UNUSED(conn);

    if (err) {
        printk("Security change failed (level %u, err %u)\n", level, err);
        return;
    }

    printk("Security level %u\n", level);

    /* Surfaces on the telemetry characteristic so a host test can assert
     * the link is actually encrypted, not just that pairing returned. */
    ha_telemetry_set_security((uint8_t)level);
}

static void pairing_complete(struct bt_conn *conn, bool bonded)
{
    ARG_UNUSED(conn);

    printk("Paired (bonded=%d)\n", (int)bonded);

    ha_telemetry_refresh_bonds();
}

static void pairing_failed(struct bt_conn *conn, enum bt_security_err reason)
{
    ARG_UNUSED(conn);

    printk("Pairing failed (reason %u)\n", reason);
}

static struct bt_conn_auth_info_cb auth_info_cb = {
    .pairing_complete = pairing_complete,
    .pairing_failed = pairing_failed,
};

static void disconnected(struct bt_conn *conn, uint8_t reason)
{
    ARG_UNUSED(conn);

    printk("Disconnected (reason %u) | in %u out %u dropped %u\n",
           reason, (unsigned)total_in, (unsigned)total_out, (unsigned)dropped);

    /* Feeds the risk engine "retry" metric. */
    ha_telemetry_note_reconnect();

    /* The link is gone, so it is no longer encrypted. Leaving the old
     * level published would let a test read a stale 2 on an open link. */
    ha_telemetry_set_security(1);

    if (current_conn) {
        bt_conn_unref(current_conn);
        current_conn = NULL;
    }

    notify_enabled = false;
    audio_stream_reset();

    /* Resume advertising, or the device is invisible until reboot and every
     * reconnect fails.
     *
     * Deferred to a work item on purpose. Calling bt_le_adv_start() directly
     * from this callback does not reliably work -- the connection is not
     * fully torn down yet, the call fails, and the device goes silent until
     * reboot. That was the real cause of the board "randomly" disappearing
     * between test runs.
     */
    k_work_schedule(&adv_work, K_MSEC(500));
}

BT_CONN_CB_DEFINE(conn_callbacks) = {
    .connected = connected,
    .disconnected = disconnected,
    .security_changed = security_changed,
};

/* ================= MAIN ================= */

#if HA_SET_STATIC_ADDR
static void set_identity_address(void)
{
    bt_addr_le_t addr;

    int err = bt_addr_le_from_str(HA_STATIC_ADDR, "random", &addr);

    if (err) {
        printk("Bad static address %s (%d)\n", HA_STATIC_ADDR, err);
        return;
    }

    /* Must run before bt_enable() to become the default identity. */
    err = bt_id_create(&addr, NULL);

    if (err < 0) {
        printk("bt_id_create failed (%d); using the built-in address\n", err);
    } else {
        printk("Identity address set to %s\n", HA_STATIC_ADDR);
    }
}
#endif

int main(void)
{
    int err;

    printk("\n=== SmartEarbuds: BLE audio DSP loopback ===\n");

#if HA_SET_STATIC_ADDR
    set_identity_address();
#endif

    err = bt_enable(NULL);
    if (err) {
        printk("Bluetooth init failed (%d)\n", err);
        return 0;
    }

    printk("Bluetooth initialized\n");

    /* Loads stored bonds. Without this a bond survives in flash but the
     * stack does not know about it, so every reconnect re-pairs and the
     * bonding test cannot tell bonding from pairing. */
    if (IS_ENABLED(CONFIG_SETTINGS)) {
        settings_load();
    }

    bt_conn_auth_info_cb_register(&auth_info_cb);

    /* Must follow bt_enable(). Publishes work-queue stack use, link drops
     * and stream errors on the telemetry characteristic once a second;
     * without it the host reports every scored metric as unmeasured. */
    err = ha_telemetry_init();
    if (err) {
        printk("Telemetry init failed (%d); metrics read as unmeasured\n", err);
    }

    wdrc_reset();

    err = bt_le_adv_start(BT_LE_ADV_CONN_FAST_1, ad, ARRAY_SIZE(ad), NULL, 0);
    if (err) {
        printk("Advertising failed (%d)\n", err);
        return 0;
    }

    printk("Advertising started as '%s'\n", CONFIG_BT_DEVICE_NAME);

#if HA_OPEN_WRITE
    printk("WARNING: audio write is unauthenticated (HA_OPEN_WRITE=1).\n");
    printk("         Bench only. Build -DHA_OPEN_WRITE=0 to require encryption.\n");
#endif

#if HA_DISCONNECT_TEST
    printk("WARNING: disconnect test enabled, dropping link every %d s.\n",
           HA_DISCONNECT_TEST_SECONDS);
    printk("         The host holds one connection per session, so each\n");
    printk("         drop interrupts whichever test is running.\n");
#endif

    while (1) {

        k_sleep(K_SECONDS(1));
        seconds_counter++;

        if (current_conn && (total_in || total_out)) {
            printk("Audio: in %u  out %u  dropped %u\n",
                   (unsigned)total_in, (unsigned)total_out, (unsigned)dropped);
        }

#if HA_DISCONNECT_TEST
        if (current_conn && seconds_counter == HA_DISCONNECT_TEST_SECONDS) {
            printk("Disconnect test: forcing disconnect\n");
            bt_conn_disconnect(current_conn, BT_HCI_ERR_REMOTE_USER_TERM_CONN);
        }
#endif
    }

    return 0;
}
```

## src/ble_telemetry_service.c
```c
/*
 * Copyright (c) 2026 Prajnaana Technologies Pvt. Ltd.
 * Original author: Dhanya Shree S
 * SPDX-License-Identifier: MIT
 *
 * Licensed under the MIT License. See LICENSE in the project root.
 */

/*
 * Device telemetry over BLE. See ble_telemetry_service.h for the wire format.
 *
 * Requires in prj.conf:
 *
 *     CONFIG_INIT_STACKS=y                # mem_used / mem_free
 *     CONFIG_THREAD_STACK_INFO=y          # mem_used / mem_free
 *
 * mem_used and mem_free are work-queue stack, not heap, so those two are what
 * they depend on: without them k_thread_stack_space_get cannot report, the
 * fields read 0 and the host treats memory as unavailable rather than as a
 * device with no memory in use. CONFIG_SYS_HEAP_RUNTIME_STATS only arms the
 * heap fallback in sample_memory(), which is compiled out here because
 * CONFIG_HEAP_MEM_POOL_SIZE is 0.
 *
 * BT_GATT_SERVICE_DEFINE below registers statically at boot, and so does the
 * audio service in main.c, so neither needs CONFIG_BT_GATT_DYNAMIC_DB -- and
 * prj.conf does not set it. Nothing else in the build depends on it either:
 * the options that do (the audio profiles, mesh, OTS, the mcumgr Bluetooth
 * transport) are all off here, and the Battery Service registers statically
 * as well.
 *
 * Built into the application via NRF_Firmware/CMakeLists.txt. Adding or
 * removing it changes the GATT attribute table, so bump HA_STATIC_ADDR in
 * main.c when you do -- a host with a cached database will not otherwise
 * re-discover the service.
 */

#include <zephyr/bluetooth/bluetooth.h>
#include <zephyr/bluetooth/services/bas.h>
#include <zephyr/drivers/adc.h>
#include <zephyr/bluetooth/gatt.h>
#include <zephyr/bluetooth/uuid.h>
#include <zephyr/kernel.h>
#include <zephyr/logging/log.h>

#include <string.h>

#include "ble_telemetry_service.h"

LOG_MODULE_REGISTER(ha_telemetry, LOG_LEVEL_INF);

/* ---------------------------------------------------------------- UUIDs */

#define TELEMETRY_SERVICE_UUID_VAL \
    BT_UUID_128_ENCODE(0x12345678, 0x1234, 0x5678, 0x1234, 0x56789abcdee0)

#define TELEMETRY_SNAPSHOT_UUID_VAL \
    BT_UUID_128_ENCODE(0x12345678, 0x1234, 0x5678, 0x1234, 0x56789abcdee1)

/* Read requires an encrypted link. This is what gives a pairing test
 * something to prove: an unpaired read must be refused and a paired read
 * must succeed. */
#define TELEMETRY_SECURE_UUID_VAL \
    BT_UUID_128_ENCODE(0x12345678, 0x1234, 0x5678, 0x1234, 0x56789abcdee2)

static struct bt_uuid_128 telemetry_service_uuid =
    BT_UUID_INIT_128(TELEMETRY_SERVICE_UUID_VAL);
static struct bt_uuid_128 telemetry_snapshot_uuid =
    BT_UUID_INIT_128(TELEMETRY_SNAPSHOT_UUID_VAL);
static struct bt_uuid_128 telemetry_secure_uuid =
    BT_UUID_INIT_128(TELEMETRY_SECURE_UUID_VAL);

/* Build id, readable without pairing: the host needs it to label a run
 * before it has done anything else. */
#define TELEMETRY_BUILD_UUID_VAL \
    BT_UUID_128_ENCODE(0x12345678, 0x1234, 0x5678, 0x1234, 0x56789abcdee3)

static struct bt_uuid_128 telemetry_build_uuid =
    BT_UUID_INIT_128(TELEMETRY_BUILD_UUID_VAL);

/* Set by CMake from git describe. The fallback matters: a tree with no
 * git history still builds, and the host must be able to tell an unknown
 * build from a known one rather than reading an empty string. */
#ifndef HA_FW_REVISION
#define HA_FW_REVISION "unversioned"
#endif

static const char build_id[] = HA_FW_REVISION;

/* ----------------------------------------------------------------- state */

/* How often to refresh and (if subscribed) notify. */
#define TELEMETRY_PERIOD_MS 1000

static struct ha_telemetry snapshot = {
    .version = HA_TELEMETRY_VERSION,
    .battery_pct = 0xFF,                     /* unknown until something sets it */
    .sync_latency_us = HA_SYNC_UNKNOWN,      /* no second device on this bench  */
    .current_ma = 0,                         /* no current sensor on the DK     */
};

/* Counters are touched from BLE callbacks and read from a timer, so keep the
 * updates atomic rather than read-modify-write on plain uint16_t. */
static atomic_t reconnects;
static atomic_t stream_errors;

static bool notify_enabled;

/* ---------------------------------------------------------- memory stats */

static void sample_memory(struct ha_telemetry *out)
{
    /*
     * What "memory in use" means on this application.
     *
     * The obvious source is the system heap, but CONFIG_HEAP_MEM_POOL_SIZE is
     * 0 here and nothing in this firmware calls k_malloc, so that number would
     * be a constant zero -- a real measurement of nothing, which reads as a
     * healthy device and is exactly the failure the telemetry service exists
     * to remove.
     *
     * The memory that actually moves is stack. The system work queue runs the
     * audio work handler, the DSP and the BLE notify path, so its high-water
     * mark is the figure worth watching: it climbs when processing deepens and
     * it is what overflows first.
     *
     * CONFIG_INIT_STACKS fills stacks with 0xAA so unused space is countable.
     * Without it k_thread_stack_space_get cannot tell used from untouched, so
     * the fields report 0 and the host treats memory as unmeasured.
     */
#if defined(CONFIG_INIT_STACKS) && defined(CONFIG_THREAD_STACK_INFO)
    size_t unused = 0;

    /*
     * Name the system work queue's thread rather than asking for the current
     * one. refresh() is called from the work queue and, once, from
     * ha_telemetry_init() on the main thread, so k_current_get() would sample
     * whichever thread happened to call and subtract its unused space from
     * CONFIG_SYSTEM_WORKQUEUE_STACK_SIZE -- reporting the work-queue stack
     * size minus another thread's headroom.
     */
    if (k_thread_stack_space_get(k_work_queue_thread_get(&k_sys_work_q),
                                 &unused) == 0) {
        size_t total = CONFIG_SYSTEM_WORKQUEUE_STACK_SIZE;

        out->mem_free = (uint32_t)unused;
        out->mem_used = (uint32_t)(total > unused ? total - unused : 0);

        return;
    }
#endif

#if (CONFIG_HEAP_MEM_POOL_SIZE > 0) && defined(CONFIG_SYS_HEAP_RUNTIME_STATS)
    /*
     * Fall back to the system heap where one exists. _system_heap is a
     * struct k_heap, not a struct sys_heap -- the sys_heap is its first
     * member. Declaring it as the wrong type happens to work by layout and
     * breaks silently if Zephyr ever reorders that struct, so take the member
     * explicitly.
     */
    extern struct k_heap _system_heap;

    struct sys_memory_stats stats;

    if (sys_heap_runtime_stats_get(&_system_heap.heap, &stats) == 0) {
        out->mem_used = (uint32_t)stats.allocated_bytes;
        out->mem_free = (uint32_t)stats.free_bytes;

        return;
    }
#endif

    /* Nothing measurable: report zero so the host reads "not available"
     * rather than "nothing in use". */
    out->mem_used = 0;
    out->mem_free = 0;
}

/* ----------------------------------------------------------------- bonds */

#if defined(CONFIG_BT_SMP)
static void count_one_bond(const struct bt_bond_info *info, void *user_data)
{
    ARG_UNUSED(info);

    uint8_t *total = user_data;

    (*total)++;
}
#endif

void ha_telemetry_refresh_bonds(void)
{
#if defined(CONFIG_BT_SMP)
    uint8_t total = 0;

    bt_foreach_bond(BT_ID_DEFAULT, count_one_bond, &total);

    snapshot.bond_count = total;
#else
    snapshot.bond_count = 0;
#endif
}

void ha_telemetry_set_security(uint8_t level)
{
    snapshot.sec_level = level;
}

/* --------------------------------------------------------------- battery */

/*
 * The supply rail, in millivolts, mapped onto a percentage.
 *
 * These are the limits of a rail, not of a cell. A product with a battery
 * would read a fuel gauge and get a state of charge; this reports where the
 * supply sits between a brown-out floor and a charged-cell ceiling, which
 * is a real measurement of a real thing and moves when the supply moves.
 *
 * The distinction matters enough to keep in the name: BATTERY_* would claim
 * more than the DK can know.
 */
#define HA_RAIL_EMPTY_MV   1800
#define HA_RAIL_FULL_MV    3600

static const struct adc_dt_spec rail_channel =
    ADC_DT_SPEC_GET(DT_PATH(zephyr_user));

static bool rail_ready;

static void battery_init(void)
{
    if (!adc_is_ready_dt(&rail_channel)) {
        printk("SAADC not ready; battery level stays unmeasured\n");

        return;
    }

    if (adc_channel_setup_dt(&rail_channel) < 0) {
        printk("SAADC channel setup failed; battery level stays unmeasured\n");

        return;
    }

    rail_ready = true;
}

static int read_rail_mv(void)
{
    int16_t raw = 0;
    struct adc_sequence sequence = {
        .buffer = &raw,
        .buffer_size = sizeof(raw),
    };

    if (!rail_ready) {
        return -ENODEV;
    }

    if (adc_sequence_init_dt(&rail_channel, &sequence) < 0) {
        return -EIO;
    }

    if (adc_read_dt(&rail_channel, &sequence) < 0) {
        return -EIO;
    }

    int32_t millivolts = raw;

    if (adc_raw_to_millivolts_dt(&rail_channel, &millivolts) < 0) {
        return -EIO;
    }

    return (int)millivolts;
}

static void sample_battery(struct ha_telemetry *out)
{
    int millivolts = read_rail_mv();

    if (millivolts < 0) {
        /* Unmeasured, and the host is told so rather than shown a default. */
        out->battery_pct = 0xFF;

        return;
    }

    if (millivolts <= HA_RAIL_EMPTY_MV) {
        out->battery_pct = 0;
    } else if (millivolts >= HA_RAIL_FULL_MV) {
        out->battery_pct = 100;
    } else {
        out->battery_pct = (uint8_t)(((millivolts - HA_RAIL_EMPTY_MV) * 100) /
                                     (HA_RAIL_FULL_MV - HA_RAIL_EMPTY_MV));
    }

    /*
     * Publish on the standard Battery Service too. A phone, a tracker or
     * any generic central reads 0x2A19 and knows nothing about this
     * project's telemetry characteristic.
     */
    bt_bas_set_battery_level(out->battery_pct);
}

/* -------------------------------------------------------------- sampling */

static void refresh(void)
{
    snapshot.version = HA_TELEMETRY_VERSION;
    snapshot.reconnects = (uint16_t)atomic_get(&reconnects);
    snapshot.stream_errors = (uint16_t)atomic_get(&stream_errors);

    sample_memory(&snapshot);
    sample_battery(&snapshot);

    ha_telemetry_refresh_bonds();
}

/* ----------------------------------------------------------------- GATT */

static ssize_t read_snapshot(struct bt_conn *conn,
                             const struct bt_gatt_attr *attr,
                             void *buf, uint16_t len, uint16_t offset)
{
    ARG_UNUSED(conn);

    /* Deliberately no refresh() here. Sampling from this thread would make
     * the memory figure depend on who is reading it. The work queue
     * refreshes the snapshot once a second, so a read returns whatever that
     * last sample recorded. */

    return bt_gatt_attr_read(conn, attr, buf, len, offset,
                             &snapshot, sizeof(snapshot));
}

static ssize_t read_bond_count(struct bt_conn *conn,
                               const struct bt_gatt_attr *attr,
                               void *buf, uint16_t len, uint16_t offset)
{
    ha_telemetry_refresh_bonds();

    return bt_gatt_attr_read(conn, attr, buf, len, offset,
                             &snapshot.bond_count,
                             sizeof(snapshot.bond_count));
}

static ssize_t read_build_id(struct bt_conn *conn,
                             const struct bt_gatt_attr *attr,
                             void *buf, uint16_t len, uint16_t offset)
{
    size_t length = strlen(build_id);

    if (length > HA_BUILD_ID_MAX) {
        length = HA_BUILD_ID_MAX;
    }

    return bt_gatt_attr_read(conn, attr, buf, len, offset,
                             build_id, length);
}

static void telemetry_ccc_changed(const struct bt_gatt_attr *attr,
                                  uint16_t value)
{
    ARG_UNUSED(attr);

    notify_enabled = (value == BT_GATT_CCC_NOTIFY);

    LOG_INF("telemetry notifications %s",
            notify_enabled ? "enabled" : "disabled");
}

BT_GATT_SERVICE_DEFINE(telemetry_svc,
    BT_GATT_PRIMARY_SERVICE(&telemetry_service_uuid),

    BT_GATT_CHARACTERISTIC(&telemetry_snapshot_uuid.uuid,
                           BT_GATT_CHRC_READ | BT_GATT_CHRC_NOTIFY,
                           BT_GATT_PERM_READ,
                           read_snapshot, NULL, &snapshot),

    BT_GATT_CCC(telemetry_ccc_changed,
                BT_GATT_PERM_READ | BT_GATT_PERM_WRITE),

    /* Encrypted read. Built only when SMP is present -- without it the
     * permission could never be satisfied and every read would fail with
     * no way to pair, which is a worse failure than an absent
     * characteristic. */
#if defined(CONFIG_BT_SMP)
    BT_GATT_CHARACTERISTIC(&telemetry_secure_uuid.uuid,
                           BT_GATT_CHRC_READ,
                           BT_GATT_PERM_READ_ENCRYPT,
                           read_bond_count, NULL, NULL),
#endif

    BT_GATT_CHARACTERISTIC(&telemetry_build_uuid.uuid,
                           BT_GATT_CHRC_READ,
                           BT_GATT_PERM_READ,
                           read_build_id, NULL, NULL),
);

#define TELEMETRY_ATTR (&telemetry_svc.attrs[1])

/* ---------------------------------------------------------------- timer */

static void telemetry_work_handler(struct k_work *work);
static K_WORK_DEFINE(telemetry_work, telemetry_work_handler);

static void telemetry_timer_handler(struct k_timer *timer)
{
    ARG_UNUSED(timer);

    /* Notifying from a timer ISR is not allowed; hand off to the work queue. */
    k_work_submit(&telemetry_work);
}

static K_TIMER_DEFINE(telemetry_timer, telemetry_timer_handler, NULL);

static void telemetry_work_handler(struct k_work *work)
{
    ARG_UNUSED(work);

    refresh();

    if (!notify_enabled) {
        return;
    }

    int err = bt_gatt_notify(NULL, TELEMETRY_ATTR, &snapshot, sizeof(snapshot));

    if (err && err != -ENOTCONN) {
        LOG_WRN("telemetry notify failed (%d)", err);
    }
}

/* ------------------------------------------------------------ public API */

void ha_telemetry_note_reconnect(void)
{
    atomic_inc(&reconnects);
}

void ha_telemetry_note_stream_error(void)
{
    atomic_inc(&stream_errors);
}

void ha_telemetry_set_sync_latency(uint16_t microseconds)
{
    snapshot.sync_latency_us = microseconds;
}

void ha_telemetry_set_current(uint16_t milliamps)
{
    snapshot.current_ma = milliamps;
}

int ha_telemetry_init(void)
{
    BUILD_ASSERT(sizeof(struct ha_telemetry) <= 20,
                 "snapshot must fit one notification at the default MTU");

    atomic_set(&reconnects, 0);
    atomic_set(&stream_errors, 0);

    snapshot.sec_level = 1;   /* BT_SECURITY_L1 until something raises it */

    /* Before the first refresh(), which samples the battery. Without this
     * the first snapshot reports unmeasured and the Battery Service sits at
     * its default until the timer comes round. */
    battery_init();

    ha_telemetry_refresh_bonds();

    refresh();

    k_timer_start(&telemetry_timer,
                  K_MSEC(TELEMETRY_PERIOD_MS),
                  K_MSEC(TELEMETRY_PERIOD_MS));

    LOG_INF("telemetry service ready (%u byte snapshot), build %s",
            (unsigned)sizeof(struct ha_telemetry), build_id);

    printk("Firmware build id: %s\n", build_id);

    return 0;
}
```

## src/dsp_wdrc.c
```c
/*
 * Copyright (c) 2026 Prajnaana Technologies Pvt. Ltd.
 * SPDX-License-Identifier: MIT
 *
 * Licensed under the MIT License. See LICENSE in the project root.
 */

/*
 * Wide dynamic range compression. See dsp_wdrc.h for the contract the host
 * regression test depends on.
 *
 * Uses float: the nRF52840 is Cortex-M4F, with a single-precision FPU.
 * If you port this to a core without an FPU, replace
 * powf() with a small gain lookup table indexed by envelope -- that is the
 * only expensive call here.
 */

#include "dsp_wdrc.h"

#include <math.h>

/* One-pole attack/release coefficients, precomputed on first use. */
static float s_attack_coef;
static float s_release_coef;
static float s_envelope;
static int s_initialised;

static void wdrc_init(void)
{
    s_attack_coef = expf(-1.0f / (WDRC_ATTACK_S * (float)WDRC_SAMPLE_RATE));
    s_release_coef = expf(-1.0f / (WDRC_RELEASE_S * (float)WDRC_SAMPLE_RATE));
    s_envelope = 0.0f;
    s_initialised = 1;
}

void wdrc_reset(void)
{
    wdrc_init();
}

void wdrc_process(int16_t *samples, size_t count)
{
    if (!s_initialised) {
        wdrc_init();
    }

    for (size_t i = 0; i < count; i++) {

        float x = (float)samples[i] / 32767.0f;
        float mag = fabsf(x);

        /* Envelope follower: fast attack, slow release. */
        float coef = (mag > s_envelope) ? s_attack_coef : s_release_coef;
        s_envelope = coef * s_envelope + (1.0f - coef) * mag;

        /* Compression gain above the knee. */
        float gain = WDRC_GAIN_CEIL;

        if (s_envelope > WDRC_KNEE) {
            gain = WDRC_GAIN_CEIL *
                   powf(s_envelope / WDRC_KNEE, (1.0f / WDRC_RATIO) - 1.0f);
        }

        if (gain > WDRC_GAIN_CEIL) {
            gain = WDRC_GAIN_CEIL;
        } else if (gain < WDRC_GAIN_FLOOR) {
            gain = WDRC_GAIN_FLOOR;
        }

        float y = x * gain;

        if (y > 1.0f) {
            y = 1.0f;
        } else if (y < -1.0f) {
            y = -1.0f;
        }

        samples[i] = (int16_t)(y * 32767.0f);
    }
}
```
